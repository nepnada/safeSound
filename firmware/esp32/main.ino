/*
 * Sound Alert System for the Hearing-Impaired
 * ESP32-S3 firmware — TFLite Micro inference + LED + haptic alerts
 *
 * Pipeline:
 *   INMP441 (I2S) → log-mel (64ch) → DS-CNN INT8 (TFLite Micro)
 *   → temporal smoothing (3 frames) → LED + vibration alerts
 *
 * Hardware:
 *   - ESP32-S3
 *   - INMP441 microphone (I2S)
 *   - WS2812B LED strip (8 LEDs)
 *   - ERM vibration motor (PWM via MOSFET)
 */

#include <Arduino.h>
#include <driver/i2s.h>
#include <FastLED.h>
#include "tensorflow/lite/micro/all_ops_resolver.h"
#include "tensorflow/lite/micro/micro_interpreter.h"
#include "tensorflow/lite/schema/schema_generated.h"
#include "model_data.h"   // TFLite model as C array (generated by convert.py)

// ── Pin config ─────────────────────────────────────────────────────────────
#define I2S_WS_PIN      15
#define I2S_SD_PIN      13
#define I2S_SCK_PIN     14
#define LED_PIN         5
#define NUM_LEDS        8
#define VIBRO_PIN       6

// ── Audio config ────────────────────────────────────────────────────────────
#define SAMPLE_RATE     16000
#define WINDOW_SAMPLES  16000   // 1 second
#define N_MELS          64
#define N_FFT           512
#define HOP_LENGTH      256

// ── Model config ────────────────────────────────────────────────────────────
#define NUM_CLASSES     6
#define TENSOR_ARENA_SIZE (80 * 1024)  // 80 KB

// ── Temporal smoothing ──────────────────────────────────────────────────────
#define SMOOTH_FRAMES   3
#define CONFIDENCE_REJECT 0.5f  // Below this → background

const float CONFIDENCE_THRESHOLD[NUM_CLASSES] = {
  0.75f,  // fire_alarm   — critical, lower threshold = more sensitive
  0.80f,  // baby_cry
  0.75f,  // choking      — critical
  0.80f,  // car_horn
  0.90f,  // doorbell     — medium, higher threshold = fewer false positives
  0.50f,  // background
};

const char* CLASS_NAMES[NUM_CLASSES] = {
  "fire_alarm", "baby_cry", "choking", "car_horn", "doorbell", "background"
};

// ── LED colors per class ─────────────────────────────────────────────────────
CRGB CLASS_COLORS[NUM_CLASSES] = {
  CRGB::Red,       // fire_alarm
  CRGB::Orange,    // baby_cry
  CRGB::Purple,    // choking
  CRGB::Yellow,    // car_horn
  CRGB::Blue,      // doorbell
  CRGB::Black,     // background
};

// ── TFLite globals ──────────────────────────────────────────────────────────
static uint8_t tensor_arena[TENSOR_ARENA_SIZE];
tflite::AllOpsResolver resolver;
const tflite::Model* model = nullptr;
tflite::MicroInterpreter* interpreter = nullptr;
TfLiteTensor* input_tensor = nullptr;
TfLiteTensor* output_tensor = nullptr;

// ── Smoothing buffer ─────────────────────────────────────────────────────────
float smooth_buffer[SMOOTH_FRAMES][NUM_CLASSES];
int smooth_idx = 0;

// ── Audio buffer ─────────────────────────────────────────────────────────────
int16_t audio_buffer[WINDOW_SAMPLES];
CRGB leds[NUM_LEDS];


// ─────────────────────────────────────────────────────────────────────────────
void setup_i2s() {
  i2s_config_t cfg = {
    .mode = (i2s_mode_t)(I2S_MODE_MASTER | I2S_MODE_RX),
    .sample_rate = SAMPLE_RATE,
    .bits_per_sample = I2S_BITS_PER_SAMPLE_32BIT,
    .channel_format = I2S_CHANNEL_FMT_ONLY_LEFT,
    .communication_format = I2S_COMM_FORMAT_STAND_I2S,
    .intr_alloc_flags = ESP_INTR_FLAG_LEVEL1,
    .dma_buf_count = 8,
    .dma_buf_len = 512,
    .use_apll = false,
  };
  i2s_pin_config_t pins = {
    .bck_io_num = I2S_SCK_PIN,
    .ws_io_num = I2S_WS_PIN,
    .data_out_num = I2S_PIN_NO_CHANGE,
    .data_in_num = I2S_SD_PIN,
  };
  i2s_driver_install(I2S_NUM_0, &cfg, 0, nullptr);
  i2s_set_pin(I2S_NUM_0, &pins);
}

void setup_tflite() {
  model = tflite::GetModel(g_model_data);
  interpreter = new tflite::MicroInterpreter(model, resolver, tensor_arena, TENSOR_ARENA_SIZE);
  interpreter->AllocateTensors();
  input_tensor = interpreter->input(0);
  output_tensor = interpreter->output(0);
  Serial.printf("TFLite: input %d bytes | arena used %d KB\n",
    input_tensor->bytes, interpreter->arena_used_bytes() / 1024);
}

// ── Read 1s of audio from I2S ────────────────────────────────────────────────
bool read_audio_window() {
  size_t bytes_read = 0;
  int32_t raw[512];
  int total = 0;
  while (total < WINDOW_SAMPLES) {
    int to_read = min(512, WINDOW_SAMPLES - total);
    i2s_read(I2S_NUM_0, raw, to_read * 4, &bytes_read, portMAX_DELAY);
    int got = bytes_read / 4;
    for (int i = 0; i < got && total < WINDOW_SAMPLES; i++) {
      audio_buffer[total++] = (int16_t)(raw[i] >> 14);
    }
  }
  return true;
}

// ── Simple log-mel spectrogram (on-device) ────────────────────────────────────
// Note: for production, use ESP-DSP library for optimized FFT
void compute_logmel(int8_t* out, float scale, int zero_point) {
  // Simplified: normalize audio → feed as float → quantize
  // In production: compute proper mel filterbank with ESP-DSP
  float norm = 0;
  for (int i = 0; i < WINDOW_SAMPLES; i++) norm += audio_buffer[i] * audio_buffer[i];
  norm = sqrtf(norm / WINDOW_SAMPLES + 1e-8f);

  int mel_time_steps = WINDOW_SAMPLES / HOP_LENGTH;
  int total = N_MELS * mel_time_steps;

  for (int i = 0; i < total; i++) {
    float v = (float)audio_buffer[(i * HOP_LENGTH) % WINDOW_SAMPLES] / (norm * 32768.0f);
    out[i] = (int8_t)((v / scale) + zero_point);
  }
}

// ── Temporal smoothing: average over SMOOTH_FRAMES ──────────────────────────
int smooth_predict(float* probs) {
  // Store current frame
  for (int c = 0; c < NUM_CLASSES; c++)
    smooth_buffer[smooth_idx][c] = probs[c];
  smooth_idx = (smooth_idx + 1) % SMOOTH_FRAMES;

  // Average
  float avg[NUM_CLASSES] = {0};
  for (int f = 0; f < SMOOTH_FRAMES; f++)
    for (int c = 0; c < NUM_CLASSES; c++)
      avg[c] += smooth_buffer[f][c] / SMOOTH_FRAMES;

  int best = 0;
  for (int c = 1; c < NUM_CLASSES; c++)
    if (avg[c] > avg[best]) best = c;

  if (avg[best] < CONFIDENCE_THRESHOLD[best]) return 5;  // background
  return best;
}

// ── Alert outputs ─────────────────────────────────────────────────────────────
void trigger_alert(int cls) {
  if (cls == 5) {  // background: silence
    fill_solid(leds, NUM_LEDS, CRGB::Black);
    FastLED.show();
    digitalWrite(VIBRO_PIN, LOW);
    return;
  }

  Serial.printf("ALERT: %s\n", CLASS_NAMES[cls]);

  // LED pattern
  for (int blink = 0; blink < 3; blink++) {
    fill_solid(leds, NUM_LEDS, CLASS_COLORS[cls]);
    FastLED.show();
    delay(150);
    fill_solid(leds, NUM_LEDS, CRGB::Black);
    FastLED.show();
    delay(100);
  }

  // Vibration pattern (different per class)
  int pulses = (cls == 0 || cls == 2) ? 5 : 3;  // critical = 5 pulses
  for (int p = 0; p < pulses; p++) {
    digitalWrite(VIBRO_PIN, HIGH);
    delay(100);
    digitalWrite(VIBRO_PIN, LOW);
    delay(80);
  }
}

// ─────────────────────────────────────────────────────────────────────────────
void setup() {
  Serial.begin(115200);
  FastLED.addLeds<WS2812B, LED_PIN, GRB>(leds, NUM_LEDS);
  FastLED.setBrightness(50);
  pinMode(VIBRO_PIN, OUTPUT);

  setup_i2s();
  setup_tflite();

  Serial.println("System ready. Listening...");
  // Startup flash
  fill_solid(leds, NUM_LEDS, CRGB::Green);
  FastLED.show();
  delay(500);
  fill_solid(leds, NUM_LEDS, CRGB::Black);
  FastLED.show();
}

void loop() {
  read_audio_window();

  float in_scale = input_tensor->params.scale;
  int in_zero = input_tensor->params.zero_point;
  compute_logmel(input_tensor->data.int8, in_scale, in_zero);

  long t0 = millis();
  interpreter->Invoke();
  long latency = millis() - t0;

  // Dequantize output
  float out_scale = output_tensor->params.scale;
  int out_zero = output_tensor->params.zero_point;
  float probs[NUM_CLASSES];
  for (int c = 0; c < NUM_CLASSES; c++)
    probs[c] = (output_tensor->data.int8[c] - out_zero) * out_scale;

  int cls = smooth_predict(probs);
  trigger_alert(cls);

  Serial.printf("[%ldms] %s (%.2f)\n", latency, CLASS_NAMES[cls], probs[cls]);
}
